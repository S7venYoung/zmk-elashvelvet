## Kconfig
```kconfig
config VELVET_NANO_REPLUG_BOOTLOADER
    bool "Enter Nano dongle bootloader after two short USB unplug/replug cycles"
    depends on SHIELD_VELVET_NANO_DONGLE && SETTINGS && ZMK_USB && RETENTION_BOOT_MODE
    default y

config VELVET_STUDIO_BINDING_ACTIONS
    bool "Run Nano administrative actions selected in Studio"
    depends on SHIELD_VELVET_NANO_DONGLE && ZMK_STUDIO && ZMK_BLE && SETTINGS && RETENTION_BOOT_MODE
    default y

config VELVET_CAT_DISPLAY
    bool "Pixel kitten status screen on the right dongle peripheral"
    depends on SHIELD_VELVET_RIGHT && SHIELD_VELVET_SPLIT_PERIPHERAL && ZMK_DISPLAY && ZMK_SPLIT_RELAY_EVENT
    select LV_USE_IMAGE
    default n

config VELVET_DASHBOARD_DISPLAY
    bool "Paired cat and Codex/system screen theme sets"
    depends on SHIELD_VELVET_SPLIT_PERIPHERAL && ZMK_DISPLAY && ZMK_SPLIT_RELAY_EVENT
    select LV_USE_IMAGE
    default n
config ZMK_BEHAVIOR_EYELASH_DFU
    bool "Eyelash numpad peripheral BLE DFU entry"
    default y
    depends on SOC_SERIES_NRF52X && DT_HAS_EYELASH_BEHAVIOR_DFU_ENABLED
    help
      Keep this behavior on the central and peripherals so the source-local
      request can be forwarded by its stable behavior ID. Only the nRF52832
      numpad executes the bootloader request.

config VELVET_PAD_LINK_DIAGNOSTICS
    bool "Temporary read-only Pad split connection logging"
    depends on SHIELD_VELVET_NANO_DONGLE && ZMK_SPLIT_BLE && ZMK_SPLIT_ROLE_CENTRAL && LOG
    default n
```

## boards/shields/prospector_lcd_169/Kconfig.shield
```kconfig
config SHIELD_PROSPECTOR_LCD_169
    def_bool $(shields_list_contains,prospector_lcd_169)
```

## boards/shields/velvet/Kconfig.defconfig
```kconfig
# Copyright (c) 2020 The ZMK Contributors
# SPDX-License-Identifier: MIT

if SHIELD_VELVET_RIGHT && !SHIELD_VELVET_PROSPECTOR_PERIPHERAL
config ZMK_KEYBOARD_NAME
    default "Velvet"
config ZMK_SPLIT_ROLE_CENTRAL
    default y
endif

if SHIELD_VELVET_PROSPECTOR_DONGLE || SHIELD_VELVET_PROSPECTOR_PERIPHERAL
config ZMK_KEYBOARD_NAME
    default "Velvet46"
config ZMK_SPLIT
    default y
endif

if SHIELD_VELVET_LEFT || SHIELD_VELVET_RIGHT || SHIELD_VELVET_PROSPECTOR_DONGLE
endif

if ZMK_BACKLIGHT
config PWM
    default y
config LED_PWM
    default y
endif # ZMK_BACKLIGHT
```

## boards/shields/velvet/Kconfig.shield
```kconfig
# Copyright (c) 2020 The ZMK Contributors
# SPDX-License-Identifier: MIT

config SHIELD_VELVET_LEFT
    def_bool $(shields_list_contains,velvet_left)

config SHIELD_VELVET_RIGHT
    def_bool $(shields_list_contains,velvet_right)

config SHIELD_VELVET_PROSPECTOR_DONGLE
    def_bool $(shields_list_contains,velvet_prospector_dongle)

config SHIELD_VELVET_NANO_DONGLE
    def_bool $(shields_list_contains,velvet_nano_dongle)

config SHIELD_VELVET_PROSPECTOR_PERIPHERAL
    def_bool $(shields_list_contains,velvet_prospector_peripheral)

config SHIELD_VELVET_SPLIT_PERIPHERAL
    def_bool $(shields_list_contains,velvet_split_peripheral)

config ZMK_SPLIT_ROLE_CENTRAL
    default y if SHIELD_VELVET_PROSPECTOR_DONGLE || SHIELD_VELVET_NANO_DONGLE

# Keyboard halves use PWM backlight; the Prospector dongle does not.
config ZMK_BACKLIGHT
    default y if SHIELD_VELVET_LEFT || (SHIELD_VELVET_RIGHT && !SHIELD_VELVET_PROSPECTOR_PERIPHERAL)
```
