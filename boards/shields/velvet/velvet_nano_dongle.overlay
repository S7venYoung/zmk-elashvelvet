/* Keep software mouse behaviors available for Studio even without default bindings. */
#ifndef ZMK_BEHAVIORS_KEEP_MKP
#define ZMK_BEHAVIORS_KEEP_MKP
#endif
#ifndef ZMK_BEHAVIORS_KEEP_MMV
#define ZMK_BEHAVIORS_KEEP_MMV
#endif
#ifndef ZMK_BEHAVIORS_KEEP_MSC
#define ZMK_BEHAVIORS_KEEP_MSC
#endif
/* Keyless central: the Nano K hosts the keyboard split without a display. */
#include <dt-bindings/zmk/matrix_transform.h>
#include "velvet-layouts.dtsi"

/ {
    chosen {
        zmk,kscan = &prospector_mock_kscan;
        zmk,physical-layout = &velvet_layout;
    };

    prospector_mock_kscan: kscan_1 {
        compatible = "zmk,kscan-mock";
        columns = <0>;
        rows = <0>;
        events = <0>;
    };

#include "velvet-numpad-transform.dtsi"
};

&velvet_layout {
    transform = <&default_transform>;
};

/* Runtime Tap Dance: available in Studio without replacing any key. */
#ifndef VELVET_RUNTIME_TAPDANCE_DEFINED
#define VELVET_RUNTIME_TAPDANCE_DEFINED
#include <behaviors/runtime_tapdance.dtsi>
#endif
