/*
 * Copyright (c) 2020 The ZMK Contributors
 *
 * SPDX-License-Identifier: MIT
 */
#include "velvet.dtsi"

&default_transform {
	col-offset = <7>;
};

&kscan0 {
    compatible = "zmk,kscan-gpio-matrix";
    row-gpios
	= <&gpio0 9 (GPIO_ACTIVE_HIGH | GPIO_PULL_DOWN)>
	, <&gpio0 10 (GPIO_ACTIVE_HIGH | GPIO_PULL_DOWN)>
	, <&gpio0 22 (GPIO_ACTIVE_HIGH | GPIO_PULL_DOWN)>
	, <&gpio0 8 (GPIO_ACTIVE_HIGH | GPIO_PULL_DOWN)>
	, <&gpio0 2 (GPIO_ACTIVE_HIGH | GPIO_PULL_DOWN)>
	;
    col-gpios
        = <&gpio1 4  GPIO_ACTIVE_HIGH>
        , <&gpio0 31  GPIO_ACTIVE_HIGH>
        , <&gpio0 29  GPIO_ACTIVE_HIGH>
        , <&gpio1 15  GPIO_ACTIVE_HIGH>
        , <&gpio1 6  GPIO_ACTIVE_HIGH>
        , <&gpio1 11  GPIO_ACTIVE_HIGH>
        ;
};


/* Match the working Nano memory-LCD VCOM configuration. */
&nice_view_spi {
    ls0xx@0 {
        serial-vcom-inversion;
        serial-vcom-interval = <33>;
    };
};
