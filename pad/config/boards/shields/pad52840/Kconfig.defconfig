## pad/config/boards/shields/pad52840/Kconfig.defconfig
```kconfig
if SHIELD_PAD52840
config ZMK_KEYBOARD_NAME
    default "Pad16"
config ZMK_USB
    default y
config ZMK_BLE
    default y
endif
```

## pad/config/west.yml
```yaml
manifest:
  remotes:
    - name: cormoran
      url-base: https://github.com/cormoran
  projects:
    - name: zmk
      remote: cormoran
      revision: main+dya
      import: app/west.yml
    - name: zephyr
      remote: cormoran
      revision: v4.1.0+zmk-fixes+nrf-half-duplex-uart
      import: true
    - name: zmk-module-devtool
      remote: cormoran
      revision: main
      import: true
  self:
    path: pad/config
```

## pad/diagnostics/Kconfig
```kconfig
config PAD_MATRIX_DIAGNOSTICS
    bool "Read-only Pad matrix GPIO diagnostics"
    default y if SHIELD_PAD52840 && ZMK_STUDIO

config PAD_MATRIX_SETTLED_PROBE
    bool "Allow explicit settled matrix probe"
    depends on PAD_MATRIX_DIAGNOSTICS
    default n
    help
      Test-only RPC operation: pause scanning, drive only the existing matrix
      output pins, read settled inputs, then resume. Never changes pin modes
      or stored settings. Disabled in normal application builds.
```

## pad/dual/Kconfig
```kconfig
config PAD_DUAL_IMAGE
    bool "Pad reboot-selectable dual images"
    default y if SHIELD_PAD52840
config PAD_DUAL_IMAGE_SLOT
    int "Pad image slot (0 standalone, 1 split peripheral)"
    range 0 1
    default 0
    depends on PAD_DUAL_IMAGE
config PAD_DUAL_RECEIVER_OFFSET
    int "Pad position offset in shared Nano keymap"
    default 61
    depends on PAD_DUAL_IMAGE
```
