/* Controlled diode-direction probe, using the latest author-provided pins. */
&pad_matrix {
    diode-direction = "row2col";
    row-gpios = <&gpio0 24 GPIO_ACTIVE_HIGH>,
                <&gpio0 13 GPIO_ACTIVE_HIGH>,
                <&gpio0 29 GPIO_ACTIVE_HIGH>,
                <&gpio0 30 GPIO_ACTIVE_HIGH>;
    col-gpios = <&gpio1 9 (GPIO_ACTIVE_HIGH | GPIO_PULL_DOWN)>,
                <&gpio0 2 (GPIO_ACTIVE_HIGH | GPIO_PULL_DOWN)>,
                <&gpio1 13 (GPIO_ACTIVE_HIGH | GPIO_PULL_DOWN)>,
                <&gpio0 28 (GPIO_ACTIVE_HIGH | GPIO_PULL_DOWN)>;
};
